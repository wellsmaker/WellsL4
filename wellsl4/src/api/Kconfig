## wellsl4/src/benchmark/Kconfig
```kconfig
menu "Benchmark Options"

module = BENCHMARK
module-str = benchmark

config EXECUTION_BENCHMARKING
	bool "timing"
	help
	    benchmarking for timing.
	    
config TRACING
	bool "tracing"
	help 
		benchmarking for trace.
		
endmenu
```

## wellsl4/src/default/Kconfig
```kconfig
menu "Default Options"

module = DEFAULT
module-str = default

config NUM_DOMAINS
	int
	default 1
	help
	    Schedule Domain numbers

config ENABLE_KERNEL_MCS
	bool
	default n
	help 
		Schedule MCS enable

config KERNEL_TIMER_INT
	int
	help
		Kernel timer interrupt IRQn value


endmenu
```

## wellsl4/src/drivers/Kconfig
```kconfig
# drivers configuration options

# Copyright (c) 2015 Intel Corporation
# SPDX-License-Identifier: Apache-2.0

osource "drivers/serial/Kconfig"
osource "drivers/timer/Kconfig"
```

## wellsl4/src/drivers/serial/Kconfig
```kconfig
# Serial driver configuration options

# Copyright (c) 2014-2015 Wind River Systems, Inc.
# SPDX-License-Identifier: Apache-2.0

menuconfig SERIAL
	bool "Serial Drivers"
	help
	  Enable options for serial drivers.

if SERIAL

comment "Capabilities"

config SERIAL_HAS_DRIVER
	bool
	help
	  This is an option to be enabled by individual serial driver
	  to signal that there is a serial driver. This is being used
	  by other drivers which are dependent on serial.

config SERIAL_SUPPORT_ASYNC
	bool
	help
	  This is an option to be enabled by individual serial driver
	  to signal that the driver and hardware supports async operation.

config SERIAL_SUPPORT_INTERRUPT
	bool
	help
	  This is an option to be enabled by individual serial driver
	  to signal that the driver and hardware supports interrupts.

config UART_ASYNC_API
	bool "Enable new asynchronous UART API [EXPERIMENTAL]"
	depends on SERIAL_SUPPORT_ASYNC
	help
	  This option enables new asynchronous UART API.

config UART_INTERRUPT_DRIVEN
	bool "Enable UART Interrupt support"
	depends on SERIAL_SUPPORT_INTERRUPT
	help
	  This option enables interrupt support for UART allowing console
	  input and other UART based drivers.

config UART_LINE_CTRL
	bool "Enable Serial Line Control API"
	help
	  This enables the API for apps to control the serial line,
	  such as baud rate, CTS and RTS.

	  Implementation is up to individual driver.

	  Says no if not sure.

config UART_DRV_CMD
	bool "Enable driver commands API"
	help
	  This enables the API to send extra commands to drivers.
	  This allows drivers to expose hardware specific functions.

	  Says no if not sure.

comment "Serial Drivers"

osource "drivers/serial/Kconfig.stm32"

endif # SERIAL
```

## wellsl4/src/lib/Kconfig
```kconfig
# Copyright (c) 2016 Intel Corporation
# SPDX-License-Identifier: Apache-2.0

osource "lib/sys/Kconfig"

menu "Libraries Options"

config JSON_LIBRARY
	bool "Build JSON library"
	help
	  Build a minimal JSON parsing/encoding library. Used by sample
	  applications such as the NATS client.

config RING_BUFFER
	bool "Enable ring buffers"
	help
	  Enable usage of ring buffers. This is similar to kernel FIFOs but ring
	  buffers manage their own buffer memory and can store arbitrary data.
	  For optimal performance, use buffer sizes that are a power of 2.

config BASE64
	bool "Enable base64 encoding and decoding"
	help
	  Enable base64 encoding and decoding functionality

config PRINTBUFFER_SIZE
	int "printk buffer size"
	default 32
	help
		Configurate Printk Function Buffer Size. 

config TEST
	bool
	default y
	help 
		Enable test process.

config ASSERT
	bool "enable assert"
	depends on TEST
	default y
	help 
		Enable assert process.

config FORCE_NO_ASSERT
	bool
	default n
	help
		Disable assert process.

config COLOUR_PRINTING
	bool "enable assert print color"
	depends on ASSERT
	default y
	help
		Enable assert process print color.

config ASSERT_LEVEL
	int "assert level"
	depends on ASSERT
	default 1
	help 
		Assert level.

config ASSERT_VERBOSE
	bool
	depends on ASSERT
	default y
	help 
		Enable print context.

config ASSERT_NO_MSG_INFO
	bool
	depends on ASSERT
	default n
	help 
		Enable print info.

config ASSERT_NO_COND_INFO
	bool
	depends on ASSERT
	default n
	help 
		Enable print conf.

config ASSERT_NO_FILE_INFO
	bool
	depends on ASSERT
	default n
	help 
		Enable print file location.


endmenu
```

## wellsl4/src/plat/arm/stm32f429i-disc1/Kconfig.defconfig
```kconfig
# STM32F4DISCOVERY board configuration

# Copyright (c) 2016 Linaro Limited.
# SPDX-License-Identifier: Apache-2.0

source "$(BOARD_DIR)/Kconfig.defconfig.series"

if BOARD_STM32F429I_DISC1

config BOARD
	default "stm32f429i_disc1"

config UART_1
    bool
	default y
	depends on UART_CONSOLE

config I2C_3
    bool
	default y
	depends on I2C

config SPI_5
    bool
	default y
	depends on SPI

endif # BOARD_STM32F429I_DISC1
```

## wellsl4/src/plat/arm/stm32f429i-disc1/Kconfig.defconfig.series
```kconfig
# ST Microelectronics STM32F4 MCU line

# Copyright (c) 2016 Linaro Limited
# SPDX-License-Identifier: Apache-2.0

# Kconfig symbols common to STM32F4 series

if SOC_SERIES_STM32F4X

source "$(BOARD_DIR)/Kconfig.defconfig.stm32f4*"
source "$(BOARD_DIR)/common/Kconfig.defconfig.series"

config SOC_SERIES
	default "stm32f4"

if GPIO_STM32

# GPIO ports A, B and C are set in ../common/Kconfig.defconfig.series

config GPIO_STM32_PORTD
    bool
	default y

config GPIO_STM32_PORTE
    bool
	default y

config GPIO_STM32_PORTH
    bool
	default y

endif # GPIO_STM32

config I2C_STM32_V1
    bool
	default y
	depends on I2C_STM32

config DMA_STM32_V1
    bool
	default y
	depends on DMA_STM32

endif # SOC_SERIES_STM32F4X
```

## wellsl4/tool/dts/bindings/bluetooth/zephyr,bt-hci-spi-slave.yaml
```yaml
# Copyright (c) 2019 Nordic Semiconductor ASA
# SPDX-License-Identifier: Apache-2.0

description: |
    Bluetooth controller node that provides Host Controller Interface (HCI)
    over SPI

compatible: "wellsl4,bt-hci-spi-slave"

include: base.yaml

on-bus: spi

properties:
    irq-gpios:
      type: phandle-array
      required: true
```

## wellsl4/tool/dts/bindings/bluetooth/zephyr,bt-hci-spi.yaml
```yaml
# Copyright (c) 2018, I-SENSE group of ICCS
# SPDX-License-Identifier: Apache-2.0

description: |
    Bluetooth module that uses WellL4's Bluetooth Host Controller Interface SPI
    driver (e.g. nRF51822)

compatible: "wellsl4,bt-hci-spi"

include: spi-device.yaml

properties:
    irq-gpios:
      type: phandle-array
      required: true

    reset-gpios:
      type: phandle-array
      required: true
```

## wellsl4/tool/dts/bindings/flash_controller/zephyr,native-posix-flash-controller.yaml
```yaml
description: Native POSIX flash controller

compatible: "wellsl4,native-posix-flash-controller"

include: flash-controller.yaml
```

## wellsl4/tool/dts/bindings/flash_controller/zephyr,sim-flash.yaml
```yaml
# SPDX-License-Identifier: Apache-2.0

description: Simulated flash memory

compatible: "wellsl4,sim-flash"

include: base.yaml

properties:
    label:
      required: true
```

## wellsl4/tool/dts/bindings/mmc/mmc-spi-slot.yaml
```yaml
# Copyright (c) 2018 Google LLC.
# SPDX-License-Identifier: Apache-2.0

description: MMC/SD/SDIO slot connected via SPI

compatible: "wellsl4,mmc-spi-slot"

include: spi-device.yaml
```

## wellsl4/tool/dts/bindings/mtd/zephyr,sim-eeprom.yaml
```yaml
# Copyright (c) 2019 Laczen
# SPDX-License-Identifier: Apache-2.0

description: WellL4 Simulated EEPROM device

compatible: "wellsl4,sim-eeprom"

include: eeprom-base.yaml

properties:
    size:
      required: true
```

## wellsl4/tool/dts/bindings/serial/zephyr,native-posix-uart.yaml
```yaml
# Copyright (c) 2019, Jan Van Winkel (jan.van_winkel@dxplore.eu)
# SPDX-License-Identifier: Apache-2.0

description: Native POSIX UART

compatible: "wellsl4,native-posix-uart"

include: uart-controller.yaml
```
